const unsigned char stjlogo [] PROGMEM = {
  0x00, 0x00, 0x00, 0x00, 0xff, 0xff, 0x80, 0xff, 0xff, 0xfe, 0x00, 0xf8, 0x00, 0x00, 0x00, 0x00, 
  0x00, 0x00, 0x07, 0xff, 0xff, 0xe0, 0xff, 0xff, 0xfe, 0x00, 0xfc, 0x00, 0x00, 0x00, 0x00, 0x00, 
  0x00, 0x0f, 0xff, 0xff, 0xf0, 0xff, 0xff, 0xfe, 0x00, 0xfe, 0x00, 0x00, 0x00, 0x00, 0x00, 0x00, 
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  0x00, 0x00, 0x00, 0x00, 0x00, 0x00, 0x00, 0x0
};

boolean display_drawing = false;

int touch_cycles_drawn = 0;
switch_channel touch_channel;

void reset_touch_cycles() {
  int16_t start_x = touch_channel.start_x;
  int16_t start_y = touch_channel.start_y;
  
  tft.fillRect(start_x,(start_y+30),118,5,ILI9341_WHITE);
  tft.fillRect(start_x,(start_y+72),118,5,ILI9341_WHITE);
  touch_cycles_drawn = 0;
}

void touch_cycle(TS_Point p) {
  int16_t start_x = touch_channel.start_x;
  int16_t start_y = touch_channel.start_y;
  
  if(touch_cycles_drawn==0)
  {
    // this is the first touch so work out where we are
    // each box is 120x107
    Serial.print("x: ");
    Serial.print(p.x);
    Serial.print(" y: ");
    Serial.println(p.y);
    if(p.x<1320 && p.y>2000)
    {
      // 1
      touch_channel = state_channels[0];
    } else if(p.x<1320 && p.y<2000)
    {
      // 2
      touch_channel = state_channels[1];
    } else if(p.x<2512 && p.x>1320 && p.y>2000)
    {
      // 3
      touch_channel = state_channels[2];
    } else if(p.x>2512 && p.y>2000)
    {
      // 4
      touch_channel = state_channels[3];
    } else if(p.x>2512 && p.y<2000)
    {
      // 5
      touch_channel = state_channels[4];
    }

  }
  
  tft.fillRect(start_x,(start_y+30),(touch_cycles_drawn*5),5,ILI9341_BLBG);
  tft.fillRect(start_x,(start_y+72),(touch_cycles_drawn*5),5,ILI9341_BLBG);
  touch_cycles_drawn++;

  if(touch_cycles_drawn==24)
  {
    // trigger something!
    reset_touch_cycles();
  }
}



void drawui() {
  // this sets out the blank UI
  tft.drawFastVLine(120,0,320,ILI9341_LGBO);
  tft.drawFastVLine(119,0,320,ILI9341_LGBO);

  tft.drawBitmap(120,107,stjlogo,120,88,ILI9341_STJC);
}

void draw_circuit_state(switch_channel circuit) {
  // this draws the whole box
  // fill the background to the correct colour
  // draw the name
  // draw the status
  // draw the desired status
  // draw any time information
  tft.setFont(&FreeSans9pt7b);

  // these used for storing calculating text bounds
  int16_t x1, y1;
  uint16_t w, h;

  String circuit_string = circuit.circuit_string;
  int16_t start_x = circuit.start_x;
  int16_t start_y = circuit.start_y;
  boolean state = circuit.state;
  boolean desired_state = circuit.desired_state;

  // this draws the two grey boxes with borders and the circuit names
  tft.fillRect(start_x,start_y,120,30,ILI9341_LGBG);
  tft.drawRect(start_x,start_y,120,30,ILI9341_LGBO);
  tft.setTextColor(ILI9341_BLACK);
  tft.setCursor((start_x+5),(start_y+21));
  tft.print(circuit_string);
  tft.fillRect(start_x,(start_y+77),120,30,ILI9341_LGBG);
  tft.drawRect(start_x,(start_y+77),120,30,ILI9341_LGBO);

  // this draws the state text with the correct colour backgrounds
  if(state==true) {
    tft.getTextBounds("ON", (start_x+80), (start_y+21), &x1, &y1, &w, &h);
    tft.fillRect((x1-5),(y1-5),(w+10),(h+10),ILI9341_BLBG);
    tft.setCursor((start_x+80),(start_y+21));
    tft.setTextColor(ILI9341_WHITE);
    tft.print("ON");
  } else {
    tft.getTextBounds("OFF", (start_x+80), (start_y+21), &x1, &y1, &w, &h);
    tft.fillRect((x1-5),(y1-5),(w+10),(h+10),ILI9341_DGBG);
    tft.setCursor((start_x+80),(start_y+21));
    tft.setTextColor(ILI9341_WHITE);
    tft.print("OFF");
  }

  // then we draw the desired state/switch
  tft.setFont(&FreeSans12pt7b);
  if(desired_state==true) {
    // blue background, white text
    tft.setTextColor(ILI9341_WHITE);
    tft.setCursor((start_x+40),(start_y+61));
    tft.getTextBounds("ON", (start_x+40), (start_y+61), &x1, &y1, &w, &h);
    tft.fillRect((x1-10),(y1-5),(w+20),(h+10),ILI9341_BLBG);
    tft.drawRect((x1-10),(y1-5),(w+20),(h+10),ILI9341_LGBO);
    tft.print("ON");
  } else {
    // light grey background, black text
    tft.setTextColor(ILI9341_BLACK);
    tft.setCursor((start_x+35),(start_y+61));
    tft.getTextBounds("ON", (start_x+40), (start_y+61), &x1, &y1, &w, &h);
    tft.fillRect((x1-10),(y1-5),(w+20),(h+10),ILI9341_LGBG);
    tft.drawRect((x1-10),(y1-5),(w+20),(h+10),ILI9341_LGBO);
    tft.print("OFF");
  }

  tft.setFont();
  tft.setTextColor(ILI9341_BLACK);

  if(circuit.show_text_time == true) {
    boolean timestamp_state = circuit.timestamp_state;
    time_t timestamp = circuit.timestamp;
    tft.setCursor((start_x+5),(start_y+88));
  
    if(timestamp_state == true)
    {
      tft.print("On at ");
    } else if(timestamp_state == false) {
      tft.print("Off at ");
    }
  
    if(hour(timestamp)<10) {
      tft.print("0");
    }
    tft.print(hour(timestamp));
    tft.print(":");
    if(minute(timestamp)<10) {
      tft.print("0");
    }
    tft.print(minute(timestamp));
    tft.print(":");
    if(second(timestamp)<10) {
      tft.print("0");
    }
    tft.print(second(timestamp));
  }
}

void draw_wifi_strength() {
  int32_t rssi = WiFi.RSSI();
  
  int bars;
  if (rssi > -55) { 
    bars = 5;
  } else if (rssi <= -55 & rssi > -65) {
    bars = 4;
  } else if (rssi <= -65 & rssi > -70) {
    bars = 3;
  } else if (rssi <= -70 & rssi > -78) {
    bars = 2;
  } else if (rssi <= -78 & rssi > -82) {
    bars = 1;
  } else {
    bars = 0;
  }

  tft.fillRect(125,183,27,27,ILI9341_WHITE);
  for (int b=0; b <= 5; b++) {
    if(b>bars)
    {
      tft.fillRect(125 + (b*4),209 - (b*3),3,(b*3)+1,ILI9341_LGBG); 
    } else {
      if(b<2)
      {
        tft.fillRect(125 + (b*4),209 - (b*3),3,(b*3)+1,ILI9341_RED);
      } else if(b<3)
      {
        tft.fillRect(125 + (b*4),209 - (b*3),3,(b*3)+1,ILI9341_ORANGE);
      } else {
        tft.fillRect(125 + (b*4),209 - (b*3),3,(b*3)+1,ILI9341_GREEN);
      }
    }
  }
}

void update_display(int channel_number) {
  draw_circuit_state(state_channels[channel_number]);
  display_channels[channel_number] = state_channels[channel_number];
}

void check_display_is_current() {
  if(display_drawing == true) {
    return;
  }

  display_drawing = true;
  // compare the display_channels to state_channels - update the display only if necessary
  for(int i=0; i<channel_count; i++) {
    if(compare_state(i) == false){
      update_display(i);
    }
  }

  display_drawing = false;
}

void update_time() {
  // update the clock shown on the display
  tft.setFont();
  tft.setCursor(165,200);
  tft.fillRect(165,200,60,7,ILI9341_WHITE);

  if(hour()<10) {
    tft.print("0");
  }
  tft.print(hour());
  tft.print(":");
  if(minute()<10) {
    tft.print("0");
  }
  tft.print(minute());
  tft.print(":");
  if(second()<10) {
    tft.print("0");
  }
  tft.print(second());
}
